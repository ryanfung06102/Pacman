#include "stm32f10x.h"
#include "Sprite.h"

// 1 = yellow, 2 = black, 0 = null
// *********************************************************************************************
// 32 different tiles
const u8 Map[40][30] = {
{31, 31, 31, 31, 31, 31, 31, 31, 31, 31, 31, 31, 31, 31, 31, 31, 31, 31, 31, 31, 31, 31, 31, 31, 31, 31, 31, 31, 31, 31},
{31, 31, 31, 31, 31, 31, 31, 31, 31, 31, 31, 31, 31, 31, 31, 31, 31, 31, 31, 31, 31, 31, 31, 31, 31, 31, 31, 31, 31, 31},
{31, 31, 31, 31, 31, 31, 31, 31, 31, 31, 31, 31, 31, 31, 31, 31, 31, 31, 31, 31, 31, 31, 31, 31, 31, 31, 31, 31, 31, 31},
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{31, 31, 31, 31, 31, 31, 31, 31, 31, 31, 31, 31, 31, 31, 31, 31, 31, 31, 31, 31, 31, 31, 31, 31, 31, 31, 31, 31, 31, 31}
};

//                       0                       0                       0                       0                       0                       0                       0
const u8 tiles[32][64] = {
{0, 0, 0, 0, 0, 0, 0, 0, 0, 0, 0, 0, 0,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 0, 0},
{0, 0, 0, 0, 3, 3, 3, 3, 0, 0, 3, 3, 0,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 0, 0},
{3, 3, 3, 3, 0, 0, 0, 0, 0, 0, 0, 0, 3,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 0, 3},
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{0, 0, 0, 0, 0, 0, 0, 0, 0, 0, 0, 0, 0,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 0, 0}
};
// *********************************************************************************************

// text
// *********************************************************************************************
unsigned char chi_1616[6][32] = {
{0x00, 0x20, 0x18, 0x60, 0x18, 0xC0, 0x19, 0xFE, 0x1B, 0xFE, 0x1F, 0x80, 0x7D, 0x80, 0x7B, 0xFF, 0x1B, 0xFF, 0x19, 0x80, 0x19, 0x86, 0x19, 0xFE, 0x19, 0xFC, 0x18, 0x00, 0x18, 0x00, 0x00, 0x00}, 
{0x01, 0x80, 0x03, 0x00, 0x0F, 0xFF, 0x7F, 0xFF, 0x70, 0x0C, 0x06, 0xAC, 0x36, 0xAC, 0x36, 0xAC, 0x7F, 0xFF, 0x7F, 0xFF, 0x36, 0xAC, 0x36, 0xAC, 0x3F, 0xAC, 0x3F, 0xAC, 0x06, 0x0C, 0x00, 0x00},
{0x00, 0x00, 0x3C, 0x03, 0x3C, 0x03, 0x31, 0xFB, 0x35, 0xFB, 0x35, 0x2B, 0x35, 0x2B, 0x75, 0x2B, 0x75, 0x2B, 0x35, 0x2B, 0x35, 0xFB, 0x35, 0xFB, 0x3C, 0x03, 0x3C, 0x03, 0x00, 0x03, 0x00, 0x00},
{0x00, 0x00, 0x30, 0x38, 0x3C, 0xF8, 0x1C, 0xE0, 0x00, 0x18, 0x7F, 0xB0, 0x7F, 0x80, 0x6A, 0xB8, 0x6A, 0x80, 0x7F, 0xB8, 0x7F, 0x86, 0x6A, 0xB6, 0x6A, 0xFE, 0x60, 0xFC, 0x00, 0x00, 0x00, 0x00},
{0x00, 0x00, 0x7F, 0xFE, 0x7F, 0xFE, 0x6C, 0x16, 0x6D, 0xD6, 0x6D, 0x56, 0x6D, 0xD6, 0x6C, 0x1E, 0x7F, 0xB6, 0x7F, 0xF6, 0x6C, 0xFE, 0x7D, 0x9E, 0x60, 0x36, 0x7F, 0xFE, 0x7F, 0xFE, 0x00, 0x00},
{0x01, 0x80, 0x07, 0x00, 0x1F, 0xFF, 0x7F, 0xFF, 0x70, 0x00, 0x0C, 0x99, 0x1D, 0xB3, 0x3F, 0x63, 0x6E, 0xFA, 0x4C, 0xEE, 0x0C, 0x6C, 0x1E, 0x7E, 0x1F, 0xE7, 0x0D, 0x83, 0x00, 0x03, 0x00, 0x00}
};

unsigned char asc2_1608[95][16]={	  
{0x00,0x00,0x00,0x00,0x00,0x00,0x00,0x00,0x00,0x00,0x00,0x00,0x00,0x00,0x00,0x00},/*" ",0*/
{0x00,0x00,0x00,0x00,0x00,0x00,0x1F,0xCC,0x00,0x0C,0x00,0x00,0x00,0x00,0x00,0x00},/*"!",1*/
{0x00,0x00,0x08,0x00,0x30,0x00,0x60,0x00,0x08,0x00,0x30,0x00,0x60,0x00,0x00,0x00},/*""",2*/
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{0x00,0x00,0x60,0x00,0x80,0x00,0x80,0x00,0x40,0x00,0x40,0x00,0x20,0x00,0x20,0x00},/*"~",94*/
}; 
// *********************************************************************************************

s16 black = 0x0000;
s16 white = 0xFFFF;
s16 green = 0x07E0;
s16 red = 0xF800;
s16 blue = 0x001F;
s16 yellow = 0xFFE0;
s16 pink = 0xECF7;
s16 lightBlue = 0x869E;
s16 orange = 0xDCA8;
s16 darkBlue = 0x0819;

s16 redOrange = 0xC800;
s16 lightOrange = 0xF480;
s16 lightYellow = 0xF5C1;
s16 skyBlue = 0x3A75;

// put your procedure and code here

void IERG3810_TFTLCD_WrReg(s16 regval){

	LCD -> LCD_REG = regval;

}

void IERG3810_TFTLCD_WrData(s16 data){

	LCD -> LCD_RAM = data;

}

void LCD_Set9341_Parameter(void){

	IERG3810_TFTLCD_WrReg(0x01);
	IERG3810_TFTLCD_WrReg(0x11);

	IERG3810_TFTLCD_WrReg(0x3A);
	IERG3810_TFTLCD_WrData(0x55);

	IERG3810_TFTLCD_WrReg(0x29);

	IERG3810_TFTLCD_WrReg(0x36);
	IERG3810_TFTLCD_WrData(0xC8);

}

void IERG3810_TFTLCD_Init(void){

	RCC -> AHBENR |= 1 << 8;
	RCC -> APB2ENR |= 1 << 3;
	RCC -> APB2ENR |= 1 << 5;
	RCC -> APB2ENR |= 1 << 6;
	RCC -> APB2ENR |= 1 << 8;
	GPIOB -> CRL &= 0xFFFFFFF0;
	GPIOB -> CRL |= 0x00000003;

	GPIOD -> CRH &= 0x00FFF000;
	GPIOD -> CRH |= 0xBB000BBB;
	GPIOD -> CRL &= 0xFF00FF00;
	GPIOD -> CRL |= 0x00BB00BB;

	GPIOE -> CRH &= 0x00000000;
	GPIOE -> CRH |= 0xBBBBBBBB;
	GPIOE -> CRL &= 0x0FFFFFFF;
	GPIOE -> CRL |= 0xB0000000;

	GPIOG -> CRH &= 0xFFF0FFFF;
	GPIOG -> CRH |= 0x000B0000;
	GPIOG -> CRL &= 0xFFFFFFF0;
	GPIOG -> CRL |= 0x0000000B;

	FSMC_Bank1 -> BTCR[6] = 0x00000000; 
	FSMC_Bank1 -> BTCR[7] = 0x00000000; 
	FSMC_Bank1E -> BWTR[6] = 0x00000000; 
	FSMC_Bank1 -> BTCR[6] |= 1 << 12; 
	FSMC_Bank1 -> BTCR[6] |= 1 << 14; 
	FSMC_Bank1 -> BTCR[6] |= 1 << 4; 
	FSMC_Bank1 -> BTCR[7] |= 0 << 28; 
	FSMC_Bank1 -> BTCR[7] |= 1 << 0; 
	FSMC_Bank1 -> BTCR[7] |= 0xF << 8; 
	FSMC_Bank1E -> BWTR[6] |= 0 << 28; 
	FSMC_Bank1E -> BWTR[6] |= 0 << 0;
	FSMC_Bank1E -> BWTR[6] |= 3 << 8; 
	FSMC_Bank1 -> BTCR[6] |= 1 << 0;
	LCD_Set9341_Parameter();
	//LCD_LIGHT_ON;
	GPIOB -> BSRR |= 0x00000001;

}

void IERG3810_TFTLCD_DrawDot(s16 x, s16 y, s16 color){

	IERG3810_TFTLCD_WrReg(0x2A); //set x position 
	IERG3810_TFTLCD_WrData(x >> 8);
	IERG3810_TFTLCD_WrData(x & 0xFF);
	IERG3810_TFTLCD_WrData(0x01); 
	IERG3810_TFTLCD_WrData(0x3F);

	IERG3810_TFTLCD_WrReg(0x2B); //set y position 
	IERG3810_TFTLCD_WrData(y >> 8); 
	IERG3810_TFTLCD_WrData(y & 0xFF); 
	IERG3810_TFTLCD_WrData(0x01);
	IERG3810_TFTLCD_WrData(0xDF);

	IERG3810_TFTLCD_WrReg(0x2C); //set point with color 
	IERG3810_TFTLCD_WrData(color);

}

// print sprite
// 0 = null, 1 = yellow, 2 = black, 3 = blue, 4 = white, 5 = red
// *********************************************************************************************
// x and y here is PIXEL POSITION not tile position
// use ToPixel() to do the translation
void PrintSprite(s16 x, s16 y, s16 Height, s16 Length, u8 Sprite[Height][Length]){
	
	s16 i, j;
	s16 height = Height, length = Length;
	s16 X = x;
	s16 Y = y; 

	IERG3810_TFTLCD_WrReg(0x2A);
	IERG3810_TFTLCD_WrData(X >> 8);
	IERG3810_TFTLCD_WrData(X & 0xFF);
	IERG3810_TFTLCD_WrData((length + X - 1) >> 8); 
	IERG3810_TFTLCD_WrData((length + X - 1) & 0xFF); 

	IERG3810_TFTLCD_WrReg (0x2B);
	IERG3810_TFTLCD_WrData(Y >> 8);
	IERG3810_TFTLCD_WrData(Y & 0xFF);
	IERG3810_TFTLCD_WrData((height + Y - 1) >> 8); 
	IERG3810_TFTLCD_WrData((height + Y - 1) & 0xFF); 

	IERG3810_TFTLCD_WrReg(0x2C);
	for (j = 0; j < height; j++) {
		for (i = 0; i < length; i++) {
			if (Sprite[j][i] == 1){
                IERG3810_TFTLCD_DrawDot(X + i, Y + j, yellow);
            }
            else if (Sprite[j][i] == 2){
                IERG3810_TFTLCD_DrawDot(X + i, Y + j, black);
            }
			else if (Sprite[j][i] == 3){
                IERG3810_TFTLCD_DrawDot(X + i, Y + j, blue);
            }
			else if (Sprite[j][i] == 4){
                IERG3810_TFTLCD_DrawDot(X + i, Y + j, white);
            }
			else if (Sprite[j][i] == 5){
                IERG3810_TFTLCD_DrawDot(X + i, Y + j, red);
            }
			else if (Sprite[j][i] == 6){
                IERG3810_TFTLCD_DrawDot(X + i, Y + j, pink);
            }
			else if (Sprite[j][i] == 7){
                IERG3810_TFTLCD_DrawDot(X + i, Y + j, lightBlue);
            }
			else if (Sprite[j][i] == 8){
                IERG3810_TFTLCD_DrawDot(X + i, Y + j, orange);
            }
			else if (Sprite[j][i] == 9){
                IERG3810_TFTLCD_DrawDot(X + i, Y + j, darkBlue);
            }
			else if (Sprite[j][i] == 10){
                IERG3810_TFTLCD_DrawDot(X + i, Y + j, redOrange);
            }
			else if (Sprite[j][i] == 11){
                IERG3810_TFTLCD_DrawDot(X + i, Y + j, lightOrange);
            }
			else if (Sprite[j][i] == 12){
                IERG3810_TFTLCD_DrawDot(X + i, Y + j, lightYellow);
            }
			else if (Sprite[j][i] == 13){
                IERG3810_TFTLCD_DrawDot(X + i, Y + j, skyBlue);
            }
		}
	}
	
}

s16 ToPixelX(s16 X){

	return X * 8 + 5;

}

s16 ToPixelY(s16 Y){

	return Y * 8 + 29;

}

void PrintMap(void){
	
	s8 i, j, I, J;
	u8 height = 8, length = 8;
	u8 mapHeight = 40, mapLength = 30;

	for (J = 0; J < mapHeight; J++){
		for (I = 0; I < mapLength; I++){
			s16 x = length * I;
			s16 y = height * J;
			IERG3810_TFTLCD_WrReg(0x2A);
			IERG3810_TFTLCD_WrData(x >> 8);
			IERG3810_TFTLCD_WrData(x & 0xFF);
			IERG3810_TFTLCD_WrData((length + x - 1) >> 8); 
			IERG3810_TFTLCD_WrData((length + x - 1) & 0xFF); 

			IERG3810_TFTLCD_WrReg (0x2B);
			IERG3810_TFTLCD_WrData(y >> 8);
			IERG3810_TFTLCD_WrData(y & 0xFF);
			IERG3810_TFTLCD_WrData((height + y - 1) >> 8); 
			IERG3810_TFTLCD_WrData((height + y - 1) & 0xFF); 

			IERG3810_TFTLCD_WrReg(0x2C);
			for (j = 0; j < height; j++) {
				for (i = 0; i < length; i++) {
					/*
					if (tiles[Map[J][I]][i + height * j] == 0){
						IERG3810_TFTLCD_DrawDot(x + i, y + (height - j), black);
					}
					*/
					if (tiles[Map[J][I]][i + height * j] == 3){
						IERG3810_TFTLCD_DrawDot(x + i, y + (height - j), blue);
					}
					else if (tiles[Map[J][I]][i + height * j] == 4){
						IERG3810_TFTLCD_DrawDot(x + i, y + (height - j), white);
					}
				}
			}
		}
	}
	
}

// repair all 8 side of the map of the input coordinate
void RepairPrintMap(s16 inputX, s16 inputY, u8 logicMap[31][28]){
	
	s16 i, j, I, J;
	s16 index;
	s16 height = 8, length = 8;
	//u8 mapHeight = 40, mapLength = 30;
	s16 directionsX[] = {0, 1, 1, 1, 0, -1, -1, -1, 0};
	s16 directionsY[] = {0, 1, 0, -1, -1, -1, 0, 1, 1};

	for (index = 0; index < 9; index++){

		//GPIOE -> ODR ^= 1 << 5;

		I = inputX + directionsX[index] + 1;
		J = inputY + directionsY[index] + 4;

		if ((Map[J][I] != 28 && Map[J][I] != 27) || (Map[J][I] == 28 && logicMap[J - 4][I - 1] != 6 && logicMap[J - 4][I - 1] != 4) || (Map[J][I] == 27 && logicMap[J - 4][I - 1] != 6 && logicMap[J - 4][I - 1] != 4)){
			s16 x = length * I;
			s16 y = height * J;
			IERG3810_TFTLCD_WrReg(0x2A);
			IERG3810_TFTLCD_WrData(x >> 8);
			IERG3810_TFTLCD_WrData(x & 0xFF);
			IERG3810_TFTLCD_WrData((length + x - 1) >> 8); 
			IERG3810_TFTLCD_WrData((length + x - 1) & 0xFF); 

			IERG3810_TFTLCD_WrReg (0x2B);
			IERG3810_TFTLCD_WrData(y >> 8);
			IERG3810_TFTLCD_WrData(y & 0xFF);
			IERG3810_TFTLCD_WrData((height + y - 1) >> 8); 
			IERG3810_TFTLCD_WrData((height + y - 1) & 0xFF); 

			IERG3810_TFTLCD_WrReg(0x2C);
			for (j = 0; j < height; j++) {
				for (i = 0; i < length; i++) {
					if (tiles[Map[J][I]][i + height * j] == 3){
						IERG3810_TFTLCD_DrawDot(x + i, y + (height - j), blue);
					}
					else if (tiles[Map[J][I]][i + height * j] == 4){
						IERG3810_TFTLCD_DrawDot(x + i, y + (height - j), white);
					}
				}
			}
		}

	}
	
}

void IERG3810_TFTLCD_FillRectangle(u16 color, u16 start_x, u16 length_x, u16 start_y, u16 length_y) {

	u32 index=0;
	IERG3810_TFTLCD_WrReg(0x2A); 
	IERG3810_TFTLCD_WrData(start_x >> 8);
	IERG3810_TFTLCD_WrData(start_x & 0xFF);
	IERG3810_TFTLCD_WrData((length_x + start_x - 1) >> 8); 
	IERG3810_TFTLCD_WrData((length_x + start_x - 1) & 0xFF);

	IERG3810_TFTLCD_WrReg(0x2B);
	IERG3810_TFTLCD_WrData(start_y >> 8);
	IERG3810_TFTLCD_WrData(start_y & 0xFF);
	IERG3810_TFTLCD_WrData((length_y + start_y - 1) >> 8); 
	IERG3810_TFTLCD_WrData((length_y + start_y - 1) & 0xFF); 

	IERG3810_TFTLCD_WrReg(0x2C);
	for (index = 0; index < length_x * length_y; index++) {
		IERG3810_TFTLCD_WrData(color);
	}

}

void IERG3810_TFTLCD_ShowChar(u16 x, u16 y, u8 ascii, u16 color, u16 bgcolor) {

	u8 i, j;
	u8 index;
	u8 height = 16, length = 8;
	if (ascii < 32 || ascii > 127) {
		return;
	}
	ascii -= 32;
	IERG3810_TFTLCD_WrReg(0x2A);
	IERG3810_TFTLCD_WrData(x >> 8);
	IERG3810_TFTLCD_WrData(x & 0xFF);
	IERG3810_TFTLCD_WrData((length + x - 1) >> 8); 
	IERG3810_TFTLCD_WrData((length + x - 1) & 0xFF); 

	IERG3810_TFTLCD_WrReg (0x2B);
	IERG3810_TFTLCD_WrData(y >> 8);
	IERG3810_TFTLCD_WrData(y & 0xFF);
	IERG3810_TFTLCD_WrData((height + y - 1) >> 8); 
	IERG3810_TFTLCD_WrData((height + y - 1) & 0xFF); 

	IERG3810_TFTLCD_WrReg(0x2C);
	for (j = 0; j < height / 8; j++) {
		for (i = 0; i < height / 2; i++) {
			for (index = 0; index < length; index++) {
				if ((asc2_1608[ascii][index * 2 + 1 - j] >> i) & 0x01) {
					IERG3810_TFTLCD_WrData(color);
				} 
				else {
					IERG3810_TFTLCD_WrData(bgcolor);
				}
			}
		}
	}

}

void IERG3810_TFTLCD_ShowChinChar(u16 x, u16 y, u8 chineseWord, u16 color, u16 bgcolor){
	
	u8 i, j;
	u8 index;
	u32 temp;
	u8 height = 16, length = 16; //***change (length becomes 16)
	if (chineseWord > 6) { //***change 
		return;
	}

	IERG3810_TFTLCD_WrReg(0x2A);
	IERG3810_TFTLCD_WrData(x >> 8);
	IERG3810_TFTLCD_WrData(x & 0xFF);
	IERG3810_TFTLCD_WrData((length + x - 1) >> 8); 
	IERG3810_TFTLCD_WrData((length + x - 1) & 0xFF); 

	IERG3810_TFTLCD_WrReg (0x2B);
	IERG3810_TFTLCD_WrData(y >> 8);
	IERG3810_TFTLCD_WrData(y & 0xFF);
	IERG3810_TFTLCD_WrData((height + y - 1) >> 8); 
	IERG3810_TFTLCD_WrData((height + y - 1) & 0xFF); 

	IERG3810_TFTLCD_WrReg(0x2C);
	for (j = 0; j < height / 8; j++) {
		for (i = 0; i < height / 2; i++) {
			for (index = 0; index < length; index++) {
				if ((chi_1616[chineseWord][index * 2 + 1 - j] >> i) & 0x01) {
					IERG3810_TFTLCD_WrData(color);
				} 
				else {
					IERG3810_TFTLCD_WrData(bgcolor);
				
				for (temp = 0; temp <= 1000; temp++);
				}
			}
		}
	}
	
}

void IERG3810_TFTLCD_ShowString(u16 x, u16 y, u8* string, u16 color, u16 bgcolor){
	
	u16 i;
	u16 j = 0;
	u8 Hor, Ver;
	u8 maxHor;
	u8 maxCharHor = 30;
	u8 maxCharVer = 20;
	Hor = maxCharHor - (x / 8);
	Ver = maxCharVer - (y / 16);
	if (x % 8 != 0){
		Hor--;
	}
	if (y % 16 != 0){
		Ver--;
	}
	maxHor = Hor; //calculate the maximum characters (in a single line) 
	
	for (i = 0; i < 0xFFFF; i++){
		if (string[i] != 0){ 	//if the string still not reach 0x00
			
			if (Hor == 0){						//if no more space for the character horizonly:
				Ver--;									//jump to the next line
				j++;				
				Hor = maxHor;           //reset the horizon counting 				
			}
			if (string[i] == 10){			//if we reach to '\n' (for this Exp3.4):
				i++;										//skip the '\n'
				Ver--;									//jump to the next line
				j++;
				Hor = maxHor;						//reset the horizon counting 		
			}
			if (Ver == 0){						//if no more space for the character vertically:
				break;									//directky jump out this printing function
			}
			//After all the condtions, print the character
			IERG3810_TFTLCD_ShowChar (x + ((maxHor - Hor) * 8), y - (16 * j), string[i], color, bgcolor);
			Hor--;
		}
		else {
			break;
		}
	}

}
// *********************************************************************************************
